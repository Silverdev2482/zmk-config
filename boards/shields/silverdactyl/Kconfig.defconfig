## boards/shields/silverdactyl/Kconfig.defconfig
```kconfig
# Copyright (c) 2020 The ZMK Contributors
# SPDX-License-Identifier: MIT

if SHIELD_SILVERDACTYL_RIGHT

config ZMK_KEYBOARD_NAME
    default "Silverdactyl"

config ZMK_SPLIT_ROLE_CENTRAL
    default y

endif

if SHIELD_SILVERDACTYL_LEFT || SHIELD_SILVERDACTYL_RIGHT

config ZMK_SPLIT
    default y

endif
```

## boards/shields/silverdactyl/Kconfig.shield
```kconfig
# Copyright (c) 2020 The ZMK Contributors
# SPDX-License-Identifier: MIT

config SHIELD_SILVERDACTYL_LEFT
    def_bool $(shields_list_contains,silverdactyl_left)

config SHIELD_SILVERDACTYL_RIGHT
    def_bool $(shields_list_contains,silverdactyl_right)
```
